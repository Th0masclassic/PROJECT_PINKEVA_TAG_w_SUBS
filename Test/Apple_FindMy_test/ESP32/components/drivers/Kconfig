## Test/Apple_FindMy_test/ESP32/components/drivers/Kconfig
```kconfig
menu "Pinqeva firmware"

config PINQEVA_DEV_BYPASS_BOOTSTRAP
    bool "Disable factory bootstrap authentication (development only)"
    default n
    help
        Development-only escape hatch for boards that do not have a
        manufacturing-injected bootstrap key. When enabled, BLE connections
        are treated as authorized after pairing and the bootstrap HMAC is not
        checked. Never enable this for production hardware.

config PINQEVA_LOG_ADVERTISEMENT_KEY
    bool "Log advertisement-key bytes (development only)"
    depends on PINQEVA_DEV_BYPASS_BOOTSTRAP
    default n
    help
        Log the 28-byte advertisement key received over the encrypted BLE
        provisioning characteristic as uppercase hexadecimal. Advertisement
        keys are public protocol material, but logging them can expose device
        identity material. Keep this disabled for production hardware.

config PINQEVA_MAINTENANCE_BUTTON_GPIO
    int "Maintenance button GPIO"
    range 0 39
    default 0
    help
        GPIO connected to the physical renewal/maintenance button. GPIO0 is
        the BOOT button on common classic ESP32 development boards.

config PINQEVA_MAINTENANCE_BUTTON_ACTIVE_LOW
    bool "Maintenance button is active-low"
    default y
    help
        Enable the internal pull-up and treat a low level as pressed.

config PINQEVA_MAINTENANCE_BUTTON_HOLD_MS
    int "Maintenance button hold time (milliseconds)"
    range 3000 10000
    default 5000
    help
        Continuous physical hold required before connectable BLE maintenance
        advertising is opened.

config PINQEVA_BUZZER_GPIO
    int "CPT-9019A-SMT-TR drive GPIO"
    range 0 39
    default 25
    help
        GPIO connected to one terminal of the externally driven piezo buzzer.
        The other terminal is connected to ground for the direct 3.3 Vpp
        development drive. Production PCBs can use a transistor or bridge
        driver for greater acoustic output within the buzzer rating.

config PINQEVA_BUZZER_FREQUENCY_HZ
    int "Piezo drive frequency (Hz)"
    range 3000 5000
    default 4000
    help
        CPT-9019A-SMT-TR rated frequency. Keep this at 4000 Hz unless acoustic
        measurements on the assembled enclosure justify another value.

config PINQEVA_FINDER_INTERVAL_MS
    int "Finder advertising interval (milliseconds)"
    range 100 2000
    default 250
    help
        Larger intervals reduce radio work but increase discovery latency.
        The default preserves the current experimental Apple/Google cadence.
        Choose a multiple of 5 ms (BLE intervals use 0.625 ms units).

config PINQEVA_FINDER_SLOT_MS
    int "Per-network advertising slot (milliseconds)"
    range 200 10000
    default 500
    help
        Time before switching Apple/Google identity on the single advertising
        set. Must be at least twice PINQEVA_FINDER_INTERVAL_MS. Larger slots
        reduce host/controller reconfiguration but delay the other network.

endmenu
```

## Test/Apple_FindMy_test/ESP32/sdkconfig.defaults
```kconfig
# Pinkeva development target baseline: classic ESP32 (Xtensa).
CONFIG_IDF_TARGET="esp32"
CONFIG_BT_ENABLED=y
CONFIG_BT_BLUEDROID_ENABLED=y
CONFIG_BT_BLE_ENABLED=y
CONFIG_BT_BLE_SMP_ENABLE=y
CONFIG_BT_BLE_SMP_BOND_NVS_FLASH=y
CONFIG_BT_BLE_42_FEATURES_SUPPORTED=y
# CONFIG_BT_BLE_50_FEATURES_SUPPORTED is not set
CONFIG_BTDM_CTRL_BLE_MAX_CONN=1
CONFIG_BTDM_CTRL_MODEM_SLEEP=y
CONFIG_PM_ENABLE=y
CONFIG_FREERTOS_USE_TICKLESS_IDLE=y
CONFIG_GPIO_CTRL_FUNC_IN_IRAM=y
CONFIG_ESP_DEFAULT_CPU_FREQ_MHZ_80=y
CONFIG_ESP_DEFAULT_CPU_FREQ_MHZ=80
CONFIG_PINQEVA_DEV_BYPASS_BOOTSTRAP=y
CONFIG_PINQEVA_BUZZER_GPIO=25
CONFIG_PINQEVA_BUZZER_FREQUENCY_HZ=4000
CONFIG_PINQEVA_FINDER_INTERVAL_MS=250
CONFIG_PINQEVA_FINDER_SLOT_MS=500
CONFIG_PARTITION_TABLE_CUSTOM=y
CONFIG_PARTITION_TABLE_CUSTOM_FILENAME="partitions_ota.csv"
CONFIG_BOOTLOADER_APP_ROLLBACK_ENABLE=y
```
